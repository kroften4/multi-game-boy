## components/engine/Kconfig
```kconfig
menu "Game Console Engine"

config ENGINE_BTN_UP_GPIO
int "Up button GPIO"
default 22

config ENGINE_BTN_DOWN_GPIO
int "Down button GPIO"
default 23 

config ENGINE_BTN_LEFT_GPIO
int "Left button GPIO"
default 19

config ENGINE_BTN_RIGHT_GPIO
int "Right button GPIO"
default 21 

endmenu
```

## main/Kconfig
```kconfig
menu "Main configuration"

config WIFI_SSID
string "WiFi SSID"

config WIFI_PASSWORD
string "WiFi password"

endmenu
```

## sdkconfig.defaults.debug
```kconfig
# CONFIG_LOG_DEFAULT_LEVEL_INFO=y
CONFIG_LOG_DEFAULT_LEVEL_DEBUG=y
CONFIG_ESP_SYSTEM_PANIC_PRINT_HALT=y
CONFIG_FREERTOS_CHECK_STACKOVERFLOW_CANARY=y
CONFIG_CPONG_FPS_CAP=5
```

## sdkconfig.defaults.linux
```kconfig
# CONFIG_LOG_DEFAULT_LEVEL_INFO=y
CONFIG_LOG_DEFAULT_LEVEL_DEBUG=y
CONFIG_ILI9486_H_RES=480
CONFIG_ILI9486_V_RES=320
CONFIG_ESP_MAIN_TASK_STACK_SIZE=8388608
```
