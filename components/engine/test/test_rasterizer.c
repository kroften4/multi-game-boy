#include "engine_test_utils.h"
#include "esp_log.h"
#include "rasterizer.h"
#include "unity.h"
#include "unity_test_runner.h"

static const char *TAG = "test_rasterizer";

bool bufs_equal(pixel_t *buf1, size_t size1, pixel_t *buf2, size_t size2,
				bool log_all)
{
	if (size1 != size2) {
		ESP_LOGE(TAG, "Different sizes: %zu != %zu", size1, size2);
		return false;
	}

	bool passed = true;
	for (size_t i = 0; i < size1; i++) {
		if (buf1[i] != buf2[i]) {
			ESP_LOGE(TAG, "%#06x != %#06x at %zu", buf1[i], buf2[i], i);
			if (!log_all)
				return false;
			passed = false;
		}
	}
	return passed;
	// return true;
}

TEST_CASE("Fill buf fully", "[rasterizer]")
{
	// clang-format off
	pixel_t buf[] = {
		0xFFFF, 0xFFFF, 0xFFFF, 0xFFFF, 0xFFFF, 0xFFFF, 0xFFFF,
		0xFFFF, 0xFFFF, 0xFFFF, 0xFFFF, 0xFFFF, 0xFFFF, 0xFFFF,
		0xFFFF, 0xFFFF, 0xFFFF, 0xFFFF, 0xFFFF, 0xFFFF, 0xFFFF,
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		0xFFFF, 0xFFFF, 0xFFFF, 0xFFFF, 0xFFFF, 0xFFFF, 0xFFFF,
	};
	pixel_t buf_expected[] = {
		0x0000, 0x0000, 0x0000, 0x0000, 0x0000, 0x0000, 0x0000,
		0x0000, 0x0000, 0x0000, 0x0000, 0x0000, 0x0000, 0x0000,
		0x0000, 0x0000, 0x0000, 0x0000, 0x0000, 0x0000, 0x0000,
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		0x0000, 0x0000, 0x0000, 0x0000, 0x0000, 0x0000, 0x0000,
	};
	// clang-format on
	struct bitmap bmp = { buf, 7, 10 };
	rast_fillrect(&bmp, 0, 0, bmp.size_x, bmp.size_y, 0x0000);
	TEST_ASSERT(bufs_equal(buf, ARR_SIZE(buf), buf_expected,
						   ARR_SIZE(buf_expected), true));
	// clang-format off
	pixel_t buf_expected2[] = {
		0x07e0, 0x07e0, 0x07e0, 0x07e0, 0x07e0, 0x07e0, 0x07e0,
		0x07e0, 0x07e0, 0x07e0, 0x07e0, 0x07e0, 0x07e0, 0x07e0,
		0x07e0, 0x07e0, 0x07e0, 0x07e0, 0x07e0, 0x07e0, 0x07e0,
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		0x07e0, 0x07e0, 0x07e0, 0x07e0, 0x07e0, 0x07e0, 0x07e0,
	};
	// clang-format on
	rast_fillrect(&bmp, 0, 0, bmp.size_x, bmp.size_y, 0x07e0);
	TEST_ASSERT(bufs_equal(buf, ARR_SIZE(buf), buf_expected2,
						   ARR_SIZE(buf_expected2), true));
}

TEST_CASE("Draw a single pixel on a bitmap", "[rasterizer]")
{
	// clang-format off
	pixel_t buf[] = {
		0xFFFF, 0xFFFF, 0xFFFF, 0xFFFF, 0xFFFF, 0xFFFF, 0xFFFF,
		0xFFFF, 0xFFFF, 0xFFFF, 0xFFFF, 0xFFFF, 0xFFFF, 0xFFFF,
		0xFFFF, 0xFFFF, 0xFFFF, 0xFFFF, 0xFFFF, 0xFFFF, 0xFFFF,
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		0xFFFF, 0xFFFF, 0xFFFF, 0xFFFF, 0xFFFF, 0xFFFF, 0xFFFF,
	};
	pixel_t buf_expected[] = {
		0xFFFF, 0xFFFF, 0xFFFF, 0xFFFF, 0xFFFF, 0xFFFF, 0xFFFF,
		0xFFFF, 0xFFFF, 0xFFFF, 0xFFFF, 0xFFFF, 0xFFFF, 0xFFFF,
		0xFFFF, 0xFFFF, 0xFFFF, 0xFFFF, 0xFFFF, 0xFFFF, 0xFFFF,
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		0xFFFF, 0xFFFF, 0xFFFF, 0xFFFF, 0xFFFF, 0xFFFF, 0xFFFF,
	};
	// clang-format on
	struct bitmap bmp = { buf, 7, 10 };
	rast_fillrect(&bmp, 4, 8, 1, 1, 0x4321);
	TEST_ASSERT(bufs_equal(buf, ARR_SIZE(buf), buf_expected,
						   ARR_SIZE(buf_expected), true));
}

TEST_CASE("Draw 2 rects on a bitmap", "[rasterizer]")
{
	// clang-format off
	pixel_t buf[] = {
		0xFFFF, 0xFFFF, 0xFFFF, 0xFFFF, 0xFFFF, 0xFFFF, 0xFFFF,
		0xFFFF, 0xFFFF, 0xFFFF, 0xFFFF, 0xFFFF, 0xFFFF, 0xFFFF,
		0xFFFF, 0xFFFF, 0xFFFF, 0xFFFF, 0xFFFF, 0xFFFF, 0xFFFF,
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		0xFFFF, 0xFFFF, 0xFFFF, 0xFFFF, 0xFFFF, 0xFFFF, 0xFFFF,
	};
	pixel_t buf_expected[] = {
		0xFFFF, 0xFFFF, 0xFFFF, 0xFFFF, 0xFFFF, 0xFFFF, 0xFFFF,
		0xFFFF, 0xFFFF, 0xABCD, 0xABCD, 0xABCD, 0xABCD, 0xFFFF,
		0xFFFF, 0xFFFF, 0xABCD, 0xABCD, 0xABCD, 0xABCD, 0xFFFF,
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		0xFFFF, 0xFFFF, 0xFFFF, 0xFFFF, 0xFFFF, 0xFFFF, 0xFFFF,
	};
	// clang-format on
	struct bitmap bmp = { buf, 7, 11 };
	rast_fillrect(&bmp, 2, 1, 4, 6, 0xABCD);
	TEST_ASSERT(bufs_equal(buf, ARR_SIZE(buf), buf_expected,
						   ARR_SIZE(buf_expected), false));
	// clang-format off
	pixel_t buf_expected2[] = {
		0xFFFF, 0xFFFF, 0xFFFF, 0xFFFF, 0xFFFF, 0xFFFF, 0xFFFF,
		0xFFFF, 0xFFFF, 0xABCD, 0xABCD, 0xABCD, 0xABCD, 0xFFFF, 
		0xFFFF, 0xFFFF, 0xABCD, 0xABCD, 0xABCD, 0xABCD, 0xFFFF, 
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		0xFFFF, 0xFFFF, 0xFFFF, 0xFFFF, 0xFFFF, 0xFFFF, 0xFFFF,
	};
	// clang-format on
	rast_fillrect(&bmp, 1, 5, 3, 5, 0x0123);
	TEST_ASSERT(bufs_equal(buf, ARR_SIZE(buf), buf_expected2,
						   ARR_SIZE(buf_expected), false));
}
